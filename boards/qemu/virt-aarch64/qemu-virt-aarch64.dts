/dts-v1/;

/ {
    model = "qemu-virt-aarch64";
    compatible = "linux,dummy-virt";
    #address-cells = <2>;
    #size-cells = <2>;

    memory@40000000 {
        device_type = "memory";
        reg = <0x0 0x40000000 0x0 0x10000000>;
    };

    pl011@9000000 {
        compatible = "arm,pl011";
        reg = <0x0 0x09000000 0x0 0x1000>;
        interrupts = <0 1 4>;
    };
};
