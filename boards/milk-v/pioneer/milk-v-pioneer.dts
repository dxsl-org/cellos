/dts-v1/;

/ {
    model = "Milk-V Pioneer";
    compatible = "sophgo,pioneer", "sophgo,sg2042";
    #address-cells = <2>;
    #size-cells = <2>;

    memory@80000000 {
        device_type = "memory";
        reg = <0x0 0x80000000 0x0 0x10000000>;
    };
};
