/dts-v1/;

/ {
    model = "StarFive VisionFive 2";
    compatible = "starfive,visionfive-2-v1.3b", "starfive,jh7110";
    #address-cells = <2>;
    #size-cells = <2>;

    memory@40000000 {
        device_type = "memory";
        reg = <0x0 0x40000000 0x0 0x10000000>;
    };
};
